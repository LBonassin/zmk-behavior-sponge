/*
 * Copyright (c) 2025 The ZMK Contributors
 *
 * SPDX-License-Identifier: MIT
 *
 * Include this file in your keymap to get the pre-defined &sponge and
 * &sk_sponge behaviors without defining them yourself.
 *
 * Usage: #include <behaviors/sponge.dtsi>
 */

/ {
    behaviors {
        sk_sponge: sponge_key {
            compatible = "zmk,behavior-sponge-key";
            #binding-cells = <1>;
        };
    };
};
