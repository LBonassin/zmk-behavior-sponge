## Kconfig
```kconfig
# Copyright (c) 2025 The ZMK Contributors
# SPDX-License-Identifier: MIT

config ZMK_BEHAVIOR_SPONGE
    bool "Sponge (mocking text) behavior"
    default y if DT_HAS_ZMK_BEHAVIOR_SPONGE_TOGGLE_ENABLED || DT_HAS_ZMK_BEHAVIOR_SPONGE_KEY_ENABLED
    help
      Enables the sponge behavior, which randomly capitalizes alpha
      keypresses to produce "mOcKiNg SpOnGeBoB" style text.
      Toggle on/off at runtime with &sponge; use &sk_sponge <KEY>
      in place of &kp <KEY> for all alpha keys you want affected.
```

## dts/bindings/behaviors/zmk,behavior-sponge-key.yaml
```yaml
# Copyright (c) 2025 The ZMK Contributors
# SPDX-License-Identifier: MIT

description: Sponge Key Behavior - outputs a keycode with random casing when sponge mode is active

compatible: "zmk,behavior-sponge-key"

include: one_param.yaml
```

## dts/bindings/behaviors/zmk,behavior-sponge-toggle.yaml
```yaml
# Copyright (c) 2025 The ZMK Contributors
# SPDX-License-Identifier: MIT

description: Sponge Toggle Behavior - toggles sponge (mocking) mode on/off

compatible: "zmk,behavior-sponge-toggle"

include: zero_param.yaml
```
